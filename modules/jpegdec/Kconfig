## modules/jpegdec/Kconfig
```kconfig
# SPDX-FileCopyrightText: Copyright The Zephyr Project Contributors
# SPDX-License-Identifier: Apache-2.0

config ZEPHYR_JPEGDEC_MODULE
	bool

config JPEGDEC
	bool "JPEGDEC JPEG decoder library"
	depends on ZEPHYR_JPEGDEC_MODULE
	help
	  Enable the JPEGDEC software JPEG decoder library.
```

## modules/jpegenc/Kconfig
```kconfig
# SPDX-FileCopyrightText: Copyright The Zephyr Project Contributors
# SPDX-License-Identifier: Apache-2.0

config ZEPHYR_JPEGENC_MODULE
	bool

config JPEGENC
	bool "JPEGENC JPEG encoder library"
	depends on ZEPHYR_JPEGENC_MODULE
	help
	  Enable the JPEGENC software JPEG encoder library.
```

## subsys/mpipe/img/Kconfig
```kconfig
# Copyright 2026 NXP
# SPDX-License-Identifier: Apache-2.0

config MPIPE_IMG
	bool "Image codec plugin support"
	help
	  Common namespace for image parsers, encoders, and decoders. Parsers
	  recover complete images from byte streams, while codec elements consume
	  and produce complete image buffers.

	  Enabling this option alone does not select a codec implementation or
	  reserve codec buffers. Each parser and codec has its own option.

if MPIPE_IMG

config MPIPE_IMG_JPEG_DECODER
	bool "Software JPEG decoder element"
	depends on ZEPHYR_JPEGDEC_MODULE
	select JPEGDEC
	help
	  Build the software JPEG decoder element using the external JPEGDEC
	  module. The decoder accepts complete JPEG images on its sink pad and
	  produces RGB565, YUV420, or NV12 frames on its source pad.

config MPIPE_IMG_JPEG_DECODER_POOL_NUM
	int "Number of buffers in the JPEG decoder's output pool"
	depends on MPIPE_IMG_JPEG_DECODER
	range 1 255
	default 2
	help
	  Number of buffers in the software JPEG decoder's internal output pool.

config MPIPE_IMG_JPEG_DECODER_MAX_OUT_FRAME_SIZE
	int "Maximum decoded output frame size in bytes"
	depends on MPIPE_IMG_JPEG_DECODER
	range 1 65535
	default 65535
	help
	  Maximum decoded frame size for the software JPEG decoder's internal
	  single-buffer pool. Zephyr net_buf lengths are 16-bit, so larger
	  decoded frames require a downstream pool with a different storage
	  strategy.

config MPIPE_IMG_JPEG_ENCODER
	bool "Software JPEG encoder element"
	depends on ZEPHYR_JPEGENC_MODULE
	select JPEGENC
	help
	  Build the software JPEG encoder element using the external JPEGENC
	  module. The encoder accepts RGB565, planar YUV420, or NV12 frames on
	  its sink pad and produces JPEG frames on its source pad.

config MPIPE_IMG_JPEG_ENCODER_POOL_NUM
	int "Number of buffers in the JPEG encoder's output pool"
	depends on MPIPE_IMG_JPEG_ENCODER
	range 1 255
	default 2
	help
	  Number of buffers in the software JPEG encoder's internal output
	  pool. Two to three buffers allow pipelining with one frame being
	  encoded while another is in flight.

config MPIPE_IMG_JPEG_ENCODER_MAX_OUT_FRAME_SIZE
	int "Maximum encoded output frame size in bytes"
	depends on MPIPE_IMG_JPEG_ENCODER
	range 1 65535
	default 65535
	help
	  Maximum encoded JPEG frame size for the software JPEG encoder's
	  internal single-buffer pool. Zephyr net_buf lengths are 16-bit, so
	  larger JPEG frames require a downstream pool with a different storage
	  strategy.

endif # MPIPE_IMG
```
