## CMakeLists.txt
```
# SPDX-License-Identifier: Apache-2.0

cmake_minimum_required(VERSION 3.28.0)
find_package(Zephyr REQUIRED HINTS $ENV{ZEPHYR_BASE})
project(mpipe_jpeg_decoder_file)

target_sources(app PRIVATE src/main.c)

file(MAKE_DIRECTORY ${CMAKE_CURRENT_BINARY_DIR}/test_fs)

target_compile_definitions(app PRIVATE
  TEST_FS_DIR="${CMAKE_CURRENT_BINARY_DIR}/test_fs"
)
```

## Kconfig
```
# SPDX-FileCopyrightText: Copyright The Zephyr Project Contributors
# SPDX-License-Identifier: Apache-2.0

mainmenu "mpipe JPEG decoder file test"

source "Kconfig.zephyr"

config MPIPE_JPEG_DECODER_FILE_KEEP_FILES
	bool "Keep JPEG input and decoded output files"
	help
	  Preserve input.jpg and output.rgb565 in the native test filesystem
	  after a successful test so they can be inspected manually.
```

## prj.conf
```kconfig
CONFIG_ZTEST=y
CONFIG_ZTEST_STACK_SIZE=8192
CONFIG_MAIN_STACK_SIZE=4096

CONFIG_FILE_SYSTEM=y
CONFIG_FILE_SYSTEM_NATIVE_MOUNT=y

CONFIG_MPIPE=y
CONFIG_MPIPE_FS=y
CONFIG_MPIPE_FS_BLOCK_SIZE=475
CONFIG_MPIPE_IMG=y
CONFIG_MPIPE_IMG_JPEG_DECODER=y
CONFIG_MPIPE_IMG_JPEG_DECODER_POOL_NUM=1
CONFIG_MPIPE_IMG_JPEG_DECODER_MAX_OUT_FRAME_SIZE=578
CONFIG_ZBUS_MSG_SUBSCRIBER=y
```

## src/main.c
```c
/*
 * SPDX-FileCopyrightText: Copyright The Zephyr Project Contributors
 * SPDX-License-Identifier: Apache-2.0
 */

#include <errno.h>
#include <stdint.h>
#include <string.h>

#include <zephyr/drivers/video.h>
#include <zephyr/fs/fs.h>
#include <zephyr/mpipe/fs/mpipe_file_sink.h>
#include <zephyr/mpipe/fs/mpipe_file_src.h>
#include <zephyr/mpipe/img/mpipe_img_jpeg_decoder.h>
#include <zephyr/mpipe/mpipe.h>
#include <zephyr/mpipe/mpipe_message.h>
#include <zephyr/mpipe/mpipe_structure.h>
#include <zephyr/sys/util.h>
#include <zephyr/zbus/zbus.h>
#include <zephyr/ztest.h>

#include "test_jpeg_17x17.h"

#define TEST_MOUNT_POINT "/test_fs"
#define TEST_INPUT_PATH  TEST_MOUNT_POINT "/input.jpg"
#define TEST_OUTPUT_PATH TEST_MOUNT_POINT "/output.rgb565"
#define TEST_WIDTH       17U
#define TEST_HEIGHT      17U
#define TEST_OUTPUT_SIZE (TEST_WIDTH * TEST_HEIGHT * sizeof(uint16_t))

ZBUS_MSG_SUBSCRIBER_DEFINE(mpipe_jpeg_decoder_subscriber);

enum {
	PIPE_ID,
	FILE_SRC_ID,
	JPEG_DECODER_ID,
	FILE_SINK_ID,
};

static struct fs_mount_t test_mount = {
	.type = FS_NATIVE_MOUNT,
	.mnt_point = TEST_MOUNT_POINT,
	.fs_data = TEST_FS_DIR,
};

static int write_file(const char *path, const uint8_t *data, size_t size)
{
	struct fs_file_t file;
	size_t offset = 0U;
	int ret;

	fs_file_t_init(&file);
	ret = fs_open(&file, path, FS_O_CREATE | FS_O_WRITE);
	if (ret != 0) {
		return ret;
	}
	while (offset < size) {
		ssize_t written = fs_write(&file, data + offset, size - offset);

		if (written <= 0) {
			ret = (written < 0) ? (int)written : -EIO;
			goto close;
		}
		offset += (size_t)written;
	}
	ret = 0;

close:
	if (fs_close(&file) != 0 && ret == 0) {
		ret = -EIO;
	}
	return ret;
}

static int read_file(const char *path, uint8_t *data, size_t capacity, size_t *size)
{
	struct fs_file_t file;
	size_t offset = 0U;
	int ret;

	fs_file_t_init(&file);
	ret = fs_open(&file, path, FS_O_READ);
	if (ret != 0) {
		return ret;
	}
	while (offset < capacity) {
		ssize_t bytes_read = fs_read(&file, data + offset, capacity - offset);

		if (bytes_read < 0) {
			ret = (int)bytes_read;
			goto close;
		}
		if (bytes_read == 0) {
			break;
		}
		offset += (size_t)bytes_read;
	}
	*size = offset;
	ret = 0;

close:
	if (fs_close(&file) != 0 && ret == 0) {
		ret = -EIO;
	}
	return ret;
}

static uint16_t get_pixel(const uint8_t *data, uint32_t x, uint32_t y)
{
	size_t offset = ((size_t)y * TEST_WIDTH + x) * sizeof(uint16_t);

	return (uint16_t)data[offset] | ((uint16_t)data[offset + 1U] << 8);
}

static void check_pixel(const uint8_t *data, uint32_t x, uint32_t y, uint8_t min_r,
			uint8_t min_g, uint8_t min_b, uint8_t max_r, uint8_t max_g, uint8_t max_b)
{
	uint16_t pixel = get_pixel(data, x, y);
	uint8_t r = (pixel >> 11) & 0x1fU;
	uint8_t g = (pixel >> 5) & 0x3fU;
	uint8_t b = pixel & 0x1fU;

	zassert_between_inclusive(r, min_r, max_r, "red at %u,%u: %u", x, y, r);
	zassert_between_inclusive(g, min_g, max_g, "green at %u,%u: %u", x, y, g);
	zassert_between_inclusive(b, min_b, max_b, "blue at %u,%u: %u", x, y, b);
}

ZTEST(mpipe_jpeg_decoder_file, test_jpeg_file_to_raw_file)
{
	static struct mpipe pipeline;
	static struct mpipe_file_src file_src;
	static struct mpipe_img_jpeg_decoder jpeg_decoder;
	static struct mpipe_file_sink file_sink;
	static uint8_t output[TEST_OUTPUT_SIZE];
	struct mpipe_structure caps;
	const struct zbus_channel *channel;
	struct zbus_channel *bus;
	struct mpipe_message message;
	uint32_t block_size = sizeof(jpeg_17x17);
	size_t output_size = 0U;

	(void)fs_unlink(TEST_INPUT_PATH);
	(void)fs_unlink(TEST_OUTPUT_PATH);
	zassert_ok(write_file(TEST_INPUT_PATH, jpeg_17x17, sizeof(jpeg_17x17)),
		   "failed to create JPEG input file");

	memset(&pipeline, 0, sizeof(pipeline));
	memset(&file_src, 0, sizeof(file_src));
	memset(&jpeg_decoder, 0, sizeof(jpeg_decoder));
	memset(&file_sink, 0, sizeof(file_sink));

	zassert_ok(mpipe_pipeline_init(&pipeline, PIPE_ID));
	zassert_ok(mpipe_file_src_init(&file_src, FILE_SRC_ID));
	zassert_ok(mpipe_img_jpeg_decoder_init(&jpeg_decoder, JPEG_DECODER_ID));
	zassert_ok(mpipe_file_sink_init(&file_sink, FILE_SINK_ID));
	zassert_ok(mpipe_structure_init_fields(
		&caps, MPIPE_MEDIA_VIDEO, MPIPE_CAPS_PIXEL_FORMAT, MPIPE_TYPE_UINT,
		VIDEO_PIX_FMT_JPEG, MPIPE_CAPS_IMAGE_WIDTH, MPIPE_TYPE_UINT, TEST_WIDTH,
		MPIPE_CAPS_IMAGE_HEIGHT, MPIPE_TYPE_UINT, TEST_HEIGHT, MPIPE_CAPS_END));
	zassert_ok(mpipe_pad_set_caps(&file_src.src.src_pad, &caps));
	zassert_ok(mpipe_object_set_properties((struct mpipe_object *)&file_src,
					       MPIPE_PROP_FS_SRC_PATH, TEST_INPUT_PATH,
					       MPIPE_PROP_FS_SRC_BLOCKSIZE, &block_size,
					       MPIPE_PROP_LIST_END));
	zassert_ok(mpipe_object_set_properties((struct mpipe_object *)&file_sink,
					       MPIPE_PROP_FS_SINK_PATH, TEST_OUTPUT_PATH,
					       MPIPE_PROP_LIST_END));
	zassert_ok(mpipe_bin_add((struct mpipe_bin *)&pipeline, (struct mpipe_element *)&file_src,
				 (struct mpipe_element *)&jpeg_decoder,
				 (struct mpipe_element *)&file_sink, NULL));
	zassert_ok(mpipe_element_link((struct mpipe_element *)&file_src,
				      (struct mpipe_element *)&jpeg_decoder,
				      (struct mpipe_element *)&file_sink, NULL));

	bus = mpipe_element_get_bus_chan((struct mpipe_element *)&pipeline);
	zassert_ok(zbus_chan_add_obs(bus, &mpipe_jpeg_decoder_subscriber, K_FOREVER));
	zassert_ok(mpipe_element_set_state((struct mpipe_element *)&pipeline, MPIPE_STATE_PLAYING));
	zassert_ok(zbus_sub_wait_msg(&mpipe_jpeg_decoder_subscriber, &channel, &message,
				     K_SECONDS(2)),
		   "timed out waiting for EOS");
	zassert_equal(message.type, MPIPE_MESSAGE_EOS, "expected EOS, got %d (code %d)",
		      message.type, message.code);
	zassert_ok(mpipe_element_set_state((struct mpipe_element *)&pipeline, MPIPE_STATE_READY));
	zassert_ok(zbus_chan_rm_obs(bus, &mpipe_jpeg_decoder_subscriber, K_FOREVER));

	zassert_ok(read_file(TEST_OUTPUT_PATH, output, sizeof(output), &output_size),
		   "failed to read decoded file");
	zassert_equal(output_size, sizeof(output), "decoded size: %zu", output_size);
	check_pixel(output, 3U, 3U, 20U, 0U, 0U, 31U, 20U, 12U);
	check_pixel(output, 13U, 3U, 0U, 35U, 0U, 15U, 63U, 15U);
	check_pixel(output, 3U, 13U, 0U, 0U, 20U, 15U, 20U, 31U);
	check_pixel(output, 13U, 13U, 22U, 45U, 22U, 31U, 63U, 31U);
	check_pixel(output, 8U, 8U, 0U, 0U, 0U, 12U, 24U, 12U);

	if (IS_ENABLED(CONFIG_MPIPE_JPEG_DECODER_FILE_KEEP_FILES)) {
		TC_PRINT("preserved %s and %s\n", TEST_INPUT_PATH, TEST_OUTPUT_PATH);
	} else {
		(void)fs_unlink(TEST_INPUT_PATH);
		(void)fs_unlink(TEST_OUTPUT_PATH);
	}
}

static void *mpipe_jpeg_decoder_file_setup(void)
{
	zassert_ok(fs_mount(&test_mount), "failed to mount native test filesystem");
	return NULL;
}

static void mpipe_jpeg_decoder_file_teardown(void *fixture)
{
	ARG_UNUSED(fixture);
	zassert_ok(fs_unmount(&test_mount), "failed to unmount native test filesystem");
}

ZTEST_SUITE(mpipe_jpeg_decoder_file, NULL, mpipe_jpeg_decoder_file_setup, NULL, NULL,
	    mpipe_jpeg_decoder_file_teardown);
```

## src/test_jpeg_17x17.h
```c
/*
 * Copyright 2026 Meta Platforms, Inc.
 *
 * SPDX-License-Identifier: Apache-2.0
 */

#ifndef TEST_JPEG_17X17_H_
#define TEST_JPEG_17X17_H_

#include <stdint.h>

static const uint8_t jpeg_17x17[] = {
	0xff, 0xd8, 0xff, 0xfe, 0x00, 0x10, 0x4c, 0x61, 0x76, 0x63, 0x36, 0x32,
	0x2e, 0x33, 0x36, 0x2e, 0x31, 0x30, 0x30, 0x00, 0xff, 0xdb, 0x00, 0x43,
	0x00, 0x08, 0x04, 0x04, 0x04, 0x04, 0x04, 0x05, 0x05, 0x05, 0x05, 0x05,
	0x05, 0x06, 0x06, 0x06, 0x06, 0x06, 0x06, 0x06, 0x06, 0x06, 0x06, 0x06,
	0x06, 0x06, 0x07, 0x07, 0x07, 0x08, 0x08, 0x08, 0x07, 0x07, 0x07, 0x06,
	0x06, 0x07, 0x07, 0x08, 0x08, 0x08, 0x08, 0x09, 0x09, 0x09, 0x08, 0x08,
	0x08, 0x08, 0x09, 0x09, 0x0a, 0x0a, 0x0a, 0x0c, 0x0c, 0x0b, 0x0b, 0x0e,
	0x0e, 0x0e, 0x11, 0x11, 0x14, 0xff, 0xc4, 0x00, 0x7d, 0x00, 0x00, 0x03,
	0x01, 0x00, 0x00, 0x00, 0x00, 0x00, 0x00, 0x00, 0x00, 0x00, 0x00, 0x00,
	0x00, 0x00, 0x00, 0x08, 0x06, 0x07, 0x01, 0x01, 0x01, 0x01, 0x01, 0x00,
	0x00, 0x00, 0x00, 0x00, 0x00, 0x00, 0x00, 0x00, 0x00, 0x00, 0x00, 0x07,
	0x03, 0x06, 0x04, 0x10, 0x00, 0x00, 0x05, 0x03, 0x01, 0x06, 0x07, 0x01,
	0x00, 0x00, 0x00, 0x00, 0x00, 0x00, 0x00, 0x00, 0x03, 0x00, 0x04, 0x06,
	0x02, 0x01, 0x07, 0x05, 0xd4, 0x17, 0x96, 0x37, 0xb5, 0x56, 0x76, 0x36,
	0x11, 0xb4, 0xd1, 0x93, 0x14, 0x75, 0x53, 0x11, 0x00, 0x00, 0x05, 0x02,
	0x03, 0x06, 0x07, 0x01, 0x00, 0x00, 0x00, 0x00, 0x00, 0x00, 0x00, 0x00,
	0x03, 0x01, 0x02, 0x04, 0x05, 0x00, 0x13, 0x11, 0x07, 0x12, 0x06, 0x17,
	0xd3, 0x55, 0x31, 0x94, 0xb2, 0xc1, 0x14, 0x71, 0x73, 0x41, 0x32, 0x34,
	0xff, 0xc0, 0x00, 0x11, 0x08, 0x00, 0x11, 0x00, 0x11, 0x03, 0x01, 0x22,
	0x00, 0x02, 0x11, 0x00, 0x03, 0x11, 0x00, 0xff, 0xda, 0x00, 0x0c, 0x03,
	0x01, 0x00, 0x02, 0x11, 0x03, 0x11, 0x00, 0x3f, 0x00, 0x8b, 0x36, 0xec,
	0xbf, 0x07, 0x37, 0x3f, 0x1b, 0x17, 0xe9, 0x02, 0x38, 0xaf, 0xd5, 0x4d,
	0xfc, 0x01, 0xf8, 0xe1, 0xec, 0x5a, 0xab, 0x65, 0x6c, 0xad, 0xb2, 0xfb,
	0x6c, 0xcb, 0x56, 0xad, 0x96, 0xd3, 0x54, 0xa5, 0x4b, 0x6b, 0x04, 0x3a,
	0x85, 0x03, 0xe0, 0xb1, 0x63, 0x0e, 0x38, 0xc2, 0xe3, 0x93, 0xcc, 0x41,
	0x45, 0x14, 0x44, 0xb2, 0x98, 0x82, 0x09, 0x3a, 0xd6, 0x53, 0x9c, 0xab,
	0x59, 0x4a, 0x55, 0xad, 0x6b, 0x5f, 0x33, 0x3d, 0xbf, 0xc9, 0x39, 0x6d,
	0x9e, 0x64, 0xc9, 0x0e, 0xe5, 0x98, 0x89, 0xea, 0x47, 0x52, 0x90, 0x60,
	0x82, 0x32, 0xb4, 0xd9, 0x0c, 0xf1, 0x25, 0x12, 0xcd, 0x1d, 0x6e, 0x16,
	0x18, 0x1f, 0xd5, 0x5f, 0x39, 0x67, 0x83, 0xce, 0x58, 0xd8, 0xa6, 0x4d,
	0xc0, 0x5c, 0x31, 0xc6, 0xba, 0x15, 0xca, 0x96, 0x32, 0x89, 0xd1, 0x0c,
	0x42, 0x85, 0x6f, 0x49, 0x10, 0x76, 0xb4, 0x99, 0x75, 0xc4, 0xcc, 0xea,
	0x48, 0x87, 0x49, 0xd9, 0x3d, 0xac, 0xe8, 0x36, 0x66, 0xef, 0x62, 0x34,
	0x64, 0xd9, 0x3d, 0xac, 0xe8, 0x36, 0x66, 0xef, 0x62, 0x34, 0x67, 0x2d,
	0xbb, 0x31, 0xf9, 0xa0, 0x5d, 0xb2, 0xf8, 0xd4, 0x7f, 0xb9, 0xf7, 0x3c,
	0xe4, 0x0e, 0xd1, 0x7c, 0x7a, 0x4f, 0x4b, 0x85, 0x69, 0xf8, 0x58, 0xc3,
	0xed, 0x56, 0xf7, 0x2b, 0x4c, 0x53, 0xd2, 0xe1, 0x5a, 0x7e, 0x16, 0x30,
	0xfb, 0x55, 0xbd, 0xca, 0xd3, 0x17, 0x0c, 0xf2, 0xfe, 0x68, 0x2f, 0x99,
	0xe7, 0x80, 0x1a, 0xd7, 0x46, 0x7e, 0x85, 0xf6, 0x4f, 0x9d, 0x50, 0x10,
	0x84, 0x27, 0x95, 0xd7, 0x5f, 0xff, 0xd9,
};

#endif /* TEST_JPEG_17X17_H_ */
```
